## Kconfig
```kconfig
# Copyright (c) 2026
# SPDX-License-Identifier: Apache-2.0

config ZEPHYR_ESP32C6_BSP
	bool "ESP32-C6 hosted-slave BSP"
	default y

if ZEPHYR_ESP32C6_BSP

rsource "drivers/Kconfig"

endif # ZEPHYR_ESP32C6_BSP

config ESP_C6_OTA_BOOT_PROBE
	bool "Resolve boot image offset from otadata at load time"
	depends on SOC_SERIES_ESP32C6
	help
	  The C6 image may be delivered into either ota_0 or ota_1 through
	  ESP-IDF-style OTA. This probes otadata / candidate offsets at
	  loader time instead of using a fixed partition offset.
```

## boards/espressif/esp32c6_evslave/Kconfig.esp32c6_evslave
```kconfig
# Copyright (c) 2026
# SPDX-License-Identifier: Apache-2.0

config BOARD_ESP32C6_EVSLAVE
	select SOC_ESP32C6_MINI_1_N4
	select SOC_ESP32C6_HPCORE if BOARD_ESP32C6_EVSLAVE_ESP32C6_HPCORE
	select SOC_ESP32C6_LPCORE if BOARD_ESP32C6_EVSLAVE_ESP32C6_LPCORE
```

## boards/espressif/esp32c6_evslave/board.yml
```yaml
# Copyright (c) 2026
# SPDX-License-Identifier: Apache-2.0

board:
  name: esp32c6_evslave
  full_name: ESP32-C6-MINI-1 hosted slave (P4 EV board)
  vendor: espressif
  socs:
  - name: esp32c6
```

## boards/espressif/esp32c6_evslave/esp32c6_evslave_hpcore_defconfig
```kconfig
# SPDX-License-Identifier: Apache-2.0

CONFIG_CONSOLE=y
CONFIG_SERIAL=y
CONFIG_UART_CONSOLE=y
CONFIG_GPIO=y
CONFIG_ESP_C6_OTA_BOOT_PROBE=y
```

## drivers/Kconfig
```kconfig
# Copyright (c) 2026
# SPDX-License-Identifier: Apache-2.0

rsource "sdio/Kconfig"
```

## drivers/sdio/Kconfig
```kconfig
# Copyright (c) 2026
# SPDX-License-Identifier: Apache-2.0

config ESP32C6_SDIO_SLAVE
	bool "ESP32-C6 SDIO slave peripheral driver"
	depends on SOC_SERIES_ESP32C6
	select EXPERIMENTAL
	help
	  Zephyr port of the ESP-IDF sdio_slave driver (esp_driver_sdio),
	  exposing the ESSL register/ring-buffer contract expected by the
	  ESP-Hosted host on the ESP32-P4.
```
